## conf/layer.conf
```bitbake
# We have a conf and classes directory, add to BBPATH
BBPATH .= ":${LAYERDIR}"

# We have recipes-* directories, add to BBFILES
BBFILES += "${LAYERDIR}/recipes-*/*.bb \
            ${LAYERDIR}/recipes-*/*.bbappend"

BBFILE_COLLECTIONS += "meta-http-server"
BBFILE_PATTERN_meta-http-server = "^${LAYERDIR}/"
BBFILE_PRIORITY_meta-http-server = "6"

LAYERDEPENDS_meta-http-server = "core"
LAYERSERIES_COMPAT_meta-http-server = "scarthgap"
```
